## conf/layer.conf
```bitbake
BBPATH := "${BBPATH}:${LAYERDIR}"

BBFILES := "${BBFILES} ${LAYERDIR}/packages/*/*.bb ${LAYERDIR}/recipes-*/*/*.bb \
	${LAYERDIR}/recipes-*/*/*.bbappend" 

BBFILE_COLLECTIONS += "maui"
BBFILE_PATTERN_maui := "^${LAYERDIR}/"
BBFILE_PRIORITY_maui = "6"
```
